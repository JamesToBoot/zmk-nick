## boards/shields/jc44/Kconfig.defconfig
```kconfig
if SHIELD_JC44_LEFT

# Name must be less than 16 characters long!
config ZMK_KEYBOARD_NAME
    default "jc44"

config ZMK_SPLIT_ROLE_CENTRAL
    default y

endif

if SHIELD_JC44_LEFT || SHIELD_JC44_RIGHT

config ZMK_SPLIT
    default y

endif
```

## boards/shields/jc44/Kconfig.shield
```kconfig
# No whitespace after the comma or in your part name!
config SHIELD_JC44_LEFT
    def_bool $(shields_list_contains,jc44_left)

# No whitespace after the comma or in your part name!
config SHIELD_JC44_RIGHT
    def_bool $(shields_list_contains,jc44_right)
```
